## conf/layer.conf
```bitbake
# We have a conf and classes directory, add to BBPATH
BBPATH .= ":${LAYERDIR}"

# We have recipes-* directories, add to BBFILES
BBFILES += "${LAYERDIR}/recipes-*/*/*.bb \
            ${LAYERDIR}/recipes-*/*/*.bbappend"

BBFILE_COLLECTIONS += "sherpya"
BBFILE_PATTERN_sherpya = "^${LAYERDIR}/"
BBFILE_PRIORITY_sherpya = "7"

# This should only be incremented on significant changes that will
# cause compatibility issues with other layers
LAYERVERSION_sherpya = "1"

LAYERDEPENDS_sherpya = "core"

LICENSE_PATH += "${LAYERDIR}/licenses"
```
